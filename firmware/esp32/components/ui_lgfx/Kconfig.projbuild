## firmware/esp32/components/ui_lgfx/Kconfig.projbuild
```kconfig
menu "UI (LovyanGFX)"

config UI_LGFX_ENABLE_INIT
    bool "Enable LovyanGFX device init (experimental)"
    default n
    help
        When enabled, initializes the LovyanGFX device and attempts to control the display.

endmenu
```
